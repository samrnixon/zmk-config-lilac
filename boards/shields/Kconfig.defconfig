## boards/shields/Kconfig.defconfig
```kconfig
if SHIELD_LILAC_LEFT

# Name must be less than 16 characters long!
config ZMK_KEYBOARD_NAME
    default "Lilac Ergo"

config ZMK_SPLIT_ROLE_CENTRAL
    default y

endif

if SHIELD_LILAC_LEFT || SHIELD_LILAC_RIGHT

config ZMK_SPLIT
    default y

endif
```

## boards/shields/Kconfig.shield
```kconfig
# No whitespace after the comma or in your part name!
config SHIELD_LILAC_LEFT
    def_bool $(shields_list_contains,lilac_left)

# No whitespace after the comma or in your part name!
config SHIELD_LILAC_RIGHT
    def_bool $(shields_list_contains,lilac_right)
```
